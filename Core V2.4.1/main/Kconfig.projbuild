## Core V2.4.1/sdkconfig.defaults
```kconfig
# Partition / Flash
CONFIG_PARTITION_TABLE_CUSTOM=y
CONFIG_PARTITION_TABLE_CUSTOM_FILENAME="partitions.csv"
CONFIG_PARTITION_TABLE_FILENAME="partitions.csv"
CONFIG_PARTITION_TABLE_OFFSET=0x8000
CONFIG_PARTITION_TABLE_MD5=y

CONFIG_ESPTOOLPY_FLASHSIZE_4MB=y
CONFIG_ESPTOOLPY_FLASHSIZE="4MB"

CONFIG_ESP_COREDUMP_ENABLE_TO_FLASH=y

# Enable Serial USB 
CONFIG_ESP_CONSOLE_USB_CDC=y
CONFIG_ESP_CONSOLE_UART_NUM=-1
CONFIG_ESP_CONSOLE_ROM_SERIAL_PORT_NUM=3
CONFIG_ESP_CONSOLE_USB_CDC_RX_BUF_SIZE=64


# Ethernet for Shlugs with it
CONFIG_ETH_USE_SPI_ETHERNET=y
CONFIG_ETH_SPI_ETHERNET_W5500=y


# Websockets
CONFIG_WS_TRANSPORT=y

CONFIG_ESP_WIFI_AUTH_OPEN=y
```

## Core-v2.4.1/main/Kconfig.projbuild
```kconfig
menu "Shlug Configuration"
    config BUTTON_TASK_STACK_SIZE
        int "stack size of button task"
    
    config BUZZER_TASK_STACK_SIZE
        int "stack size of button task"
    
    config CARD_TASK_STACK_SIZE
        int "stack size of card reader task"
                
    config IO_TASK_STACK_SIZE
        int "stack size of IO task"
    
    config LED_TASK_STACK_SIZE
        int "stack size of led task"
    
    config TEMP_TASK_STACK_SIZE
        int "stack size of temperature task"
    
    config NETWORK_TASK_STACK_SIZE
        int "stack size of network task"
                
    config USB_TASK_STACK_SIZE
        int "stack size of network task"
    
    config WSACS_TASK_STACK_SIZE
        int "stack size of WSACS task"
        
        
    endmenu
    
```

## Core-v2.4.1/sdkconfig.defaults
```kconfig
# Partition / Flash
CONFIG_PARTITION_TABLE_CUSTOM=y
CONFIG_PARTITION_TABLE_CUSTOM_FILENAME="partitions.csv"
CONFIG_PARTITION_TABLE_FILENAME="partitions.csv"
CONFIG_PARTITION_TABLE_OFFSET=0x8000
CONFIG_PARTITION_TABLE_MD5=y

CONFIG_ESPTOOLPY_FLASHSIZE_4MB=y
CONFIG_ESPTOOLPY_FLASHSIZE="4MB"
CONFIG_ESPTOOLPY_HEADER_FLASHSIZE_UPDATE=y

CONFIG_ESP_PHY_INIT_DATA_IN_PARTITION=y
CONIFG_ESP_PHY_DEFAULT_INIT_IF_INVALID=y

# Coredump
CONFIG_ESP_COREDUMP_ENABLE_TO_FLASH=y
CONFIG_ESP_COREDUMP_DATA_FORMAT_ELF=y
CONFIG_ESP_COREDUMP_CHECKSUM_CRC32=y


# Ethernet for Shlugs with it
CONFIG_ETH_USE_SPI_ETHERNET=y
CONFIG_ETH_SPI_ETHERNET_W5500=y

# Websockets
CONFIG_WS_TRANSPORT=y

# TinyUSB Stack
#
CONFIG_TINYUSB_DEBUG_LEVEL=0

#
# TinyUSB task configuration
#
# CONFIG_TINYUSB_NO_DEFAULT_TASK is not set
CONFIG_TINYUSB_TASK_PRIORITY=5
CONFIG_TINYUSB_TASK_STACK_SIZE=4096
# end of TinyUSB task configuration

#
# Descriptor configuration
#
CONFIG_TINYUSB_DESC_CUSTOM_VID=0x303a
CONFIG_TINYUSB_DESC_CUSTOM_PID=0x82d0
CONFIG_TINYUSB_DESC_MANUFACTURER_STRING="RIT SHED Makerspace"

# How it appears in Linux Webserial
CONFIG_TINYUSB_DESC_PRODUCT_STRING="ACS Core v2.4.1"
# How it appears in Windows Webserial
CONFIG_TINYUSB_DESC_CDC_STRING="ACS Core v2.4.1"

CONFIG_TINYUSB_DESC_BCD_DEVICE=0x0001
CONFIG_TINYUSB_DESC_SERIAL_STRING="123456789"

# end of Descriptor configuration

CONFIG_LOG_COLORS=y
CONFIG_NEWLIB_NANO_FORMAT=y
#
# Communication Device Class (CDC)
#
CONFIG_TINYUSB_CDC_ENABLED=y
CONFIG_TINYUSB_CDC_COUNT=1
CONFIG_TINYUSB_CDC_RX_BUFSIZE=96
CONFIG_TINYUSB_CDC_TX_BUFSIZE=96
# end of Communication Device Class (CDC)

 #
# Musical Instrument Digital Interface (MIDI)
#
CONFIG_TINYUSB_MIDI_COUNT=0
# end of Musical Instrument Digital Interface (MIDI)
```
